/* Script for -z combreloc: combine and sort reloc sections */
OUTPUT_FORMAT("elf32-shl", "elf32-shl",
	      "elf32-shl")
OUTPUT_ARCH(sh)
ENTRY(start)
LOAD_OFFSET = DEFINED(LOAD_OFFSET) ? LOAD_OFFSET : 0x8c010000 ;

SECTIONS
{
  /* Read-only sections, merged into text segment: */
  PROVIDE (__executable_start = LOAD_OFFSET); . = LOAD_OFFSET;
  .text           :
  {
    /* Sh4Fit: explicit order for .text; the original statement below places the rest */
    *crt1.o(.text)
    *(.text.init_poly.constprop.0)
    *libc.a:libc_a-memset.o(.text)
    *libgcc.a:_lshrdi3.o(.text)
    *(.text.timer_getticks.lto_priv.0)
    *(.text.timer_ns_gettime64)
    *(.text.thd_update_cpu_time)
    *(.text.thd_schedule_inner.lto_priv.0)
    *(.text.timer_ms_gettime64)
    *(.text.thd_choose_new)
    *(.text.thd_remove_from_runnable.isra.0)
    *(.text.thd_add_to_runnable)
    *(.text.thd_schedule)
    *(.text.FixedDivFloat)
    *(.text.R_CheckBBox)
    *(.text.R_Subsector)
    *(.text.maple_driver_foreach)
    *(.text.maple_enum_dev)
    *(.text.maple_enum_type)
    *(.text.vec_length.lto_priv.0.lto_priv.0)
    *(.text.light_vert.constprop.0)
    *(.text.vec_normalize.lto_priv.0.lto_priv.0)
    *(.text.tnl_poly.constprop.0)
    *libc.a:libc_a-memcpy.o(.text)
    *(.text.assign_lightcolor.lto_priv.0)
    *libkallisti.a:sq_fast_cpy.o(.text)
    *(.text.bump_atan2f.lto_priv.0)
    *array_fast_copy.o(.text)
    *(.text.R_RenderBSPNodeNoClip)
    *(.text.decode_bm_pixel)
    *(.text.decode_bumpmap)
    *(.text.R_Ident.lto_priv.0.lto_priv.0)
    *(.text.pvr_fog_table_linear)
    *(.text.color_lerp)
    *(.text.nearz_clip.lto_priv.0)
    *(.text.comp_keys.lto_priv.0)
    *(.text.is_in_hashtable.constprop.0)
    *(.text.hash.lto_priv.0)
    *(.text.np2.lto_priv.0.lto_priv.0)
    *(.text.W_S2_CheckNumForName)
    *libc.a:libc_a-strlen.o(.text)
    *(.text.T_FadeInBrightness)
    *(.text.P_SetLightFactor)
    *(.text.P_UseSpecialLine)
    *libgcc.a:_div_table.o(.text)
    *(.text.pvr_txr_load_ex)
    *(.text.P_CheckSight)
    *libgcc.a:_divdi3.o(.text)
    *libkallisti.a:entry.o(.text)
    *(.text.DecodeJaguar)
    *libkallisti.a:thdswitch.o(.text)
    *(.text.I_SystemTicker)
    *(.text.thd_pass)
    *(.text.irq_handle_exception)
    *(.text.handler_irq9.lto_priv.0)
    *(.text.mutex_unlock_common.lto_priv.0)
    *(.text.irq_set_priority)
    *(.text.genwait_wake_one)
    *(.text.MD5Transform.constprop.0)
    *(.text.clip_poly.constprop.0)
    *(.text.T_Combine)
    *(.text.P_CachePvrTexture)
    *(.text.W_CacheLumpNum)
    *(.text.memcmp)
    *(.text.M_MenuTicker)
    *(.text.R_AddSprite)
    *(.text.I_Random)
    *(.text._dtoa_r)
    *(.text.pvr_dma_transfer)
    *(.text.pvr_dest_addr)
    *(.text.dma_map_src_dst.lto_priv.0)
    *libkallisti.a:cache.o(.text)
    *(.text._strtod_l)
    *(.text.timer_stop)
    *(.text.timer_disable_ints)
    *(.text.pvr_list_prim)
    *(.text.D_NoPakTicker)
    *(.text.genwait_wake_cnt)
    *(.text.G_DoLoadLevel)
    *(.text.R_RenderSkyPic)
    *(.text.FindNearestColor.constprop.0)
    *(.text.S_InitReverb.lto_priv.0)
    *(.text.P_Ticker)
    *(.text.__ssvfiscanf_r)
    *(.text.vblfunc)
    *(.text.vblank_handler.lto_priv.0)
    *(.text.iso_vblank)
    *(.text.__ssvfscanf_r)
    *(.text.R_PointToAngle2)
    *(.text.SlopeDiv)
    *(.text.D_DoomMain)
    *(.text.W_GetNameForNum)
    *(.text.strncpy)
    *(.text.BufferedDrawSprite)
    *(.text.T_SequenceGlow)
    *(.text.P_SpawnSequenceLight)
    *(.text.Z_Malloc2)
    *(.text.P_RemoveThinker)
    *(.text.P_TryMove2)
    *(.text.R_PointInSubsector)
    *(.text.PB_CheckPosition)
    *(.text.P_SetThingPosition)
    *(.text.P_UnsetThingPosition)
    *(.text.PB_UnsetThingPosition.part.0)
    *(.text.P_SpawnMissile)
    *(.text.maple_vbl_irq_hnd)
    *(.text.maple_frame_lock)
    *(.text.maple_addr)
    *(.text.kbd_periodic)
    *(.text.mouse_periodic)
    *(.text.sip_periodic)
    *(.text.cont_periodic)
    *(.text.dreameye_periodic)
    *(.text.pvr_mem_available)
    *(.text.mALLINFo.lto_priv.0)
    *(.text.P_AddSectorSpecial)
    *(.text.pvr_dma_irq_hnd.lto_priv.0)
    *(.text.dma_next_list)
    *(.text.pvr_dma_load_ta)
    *(.text.mutex_unlock_as_thread.isra.0)
    *(.text.vid_set_mode)
    *(.text.W_S2_CacheLumpNum.constprop.0)
    *(.text.snd_mem_malloc)
    *(.text.timer_start)
    *(.text.timer_primary_wakeup)
    *(.text.timer_prime_apply.isra.0)
    *(.text.timer_clear)
    *(.text.timer_enable_ints)
    *(.text.scif_spi_write_byte)
    *(.text.P_BlockLinesIterator)
    *(.text.P_PathTraverse)
    *(.text.PIT_AddLineIntercepts)
    *(.text.P_InterceptLine.constprop.0)
    *(.text.P_BlockThingsIterator)
    *(.text.PIT_AddThingIntercepts)
    *(.text.D_WarningTicker)
    *(.text.mutex_trylock)
    *(.text.cdrom_get_status)
    *(.text.mutex_lock_irqsafe)
    *(.text._puts_r)
    *(.text.maple_queue_frame)
    *(.text.maple_frame_init)
    *(.text.net_ipv6_input)
    *(.text.mutex_lock_timed)
    *(.text.sq_lock)
    *(.text.mutex_lock)
    *(.text.T_LightFlash)
    *(.text.P_Stop)
    *(.text.pvr_sync_stats.part.0)
    *(.text.F_Ticker)
    *(.text.irq_set_handler)
    *(.text.fs_symlink)
    *(.text.tp_handler.lto_priv.0)
    *(.text.thd_timer_hnd.lto_priv.0)
    *(.text.arch_main)
    *(.text.pvr_prim)
    *(.text.pvr_blank_polyhdr)
    *(.text.pvr_scene_finish)
    *(.text.pvr_list_begin)
    *(.text.pvr_list_finish)
    *(.text.sq_unlock)
    *(.text.mutex_unlock)
    *(.text.pvr_sq_set32)
    *crtbegin.o(.text)
    *(.text.g2_fifo_wait)
    *(.text.snd_sh4_to_aica)
    *(.text.__gethex)
    *(.text.pvr_int_handler)
    *(.text.R_InitData)
    *(.text.cdrom_check_drive_ready.lto_priv.0)
    *(.text.cdrom_poll.lto_priv.0)
    *(.text.syscall_gdrom_check_drive)
    *(.text.T_VerticalDoor)
    *(.text.cont_poll)
    *(.text.dbglog)
    *(.text.cond_signal)
    *(.text._svfprintf_r)
    *(.text.vbl_autodet_callback)
    *(.text.maple_dma_irq_hnd)
    *(.text.cont_reply)
    *(.text.malloc_irq_safe)
    *(.text.__tzcalc_limits)
    *(.text.I_GetControllerData)
    *(.text.maple_dev_status)
    *(.text._strtoull_l.isra.0)
    *(.text.genwait_unqueue.lto_priv.0)
    *(.text.T_StrobeFlash)
    *(.text.ramdisk_stat)
    *(.text.sq_set32)
    *(.text.A_Look)
    *(.text.P_LookForPlayers)
    *(.text.P_AproxDistance)
    *(.text.pvr_init)
    *(.text.pvr_vblank_handler)
    *(.text.pvr_render_lists)
    *(.text.pvr_sync_reg_buffer)
    *(.text.genwait_wake_all)
    *(.text.dma_transfer)
    *libgcc.a:_ctzsi2.o(.text)
    *(.text.pvr_poly_compile)
    *(.text.dma_wait_complete)
    *(.text.iso_read)
    *(.text.g2_lock.lto_priv.0.lto_priv.0)
    *(.text.g2_read_32)
    *(.text.g2_unlock.lto_priv.0.lto_priv.0)
    *(.text.P_CalcHeight.constprop.0)
    *(.text.Z_Free2.isra.0)
    *(.text.chacha_encrypt_bytes.part.0)
    *(.text.cond_wait_timed)
    *(.text.thd_detach)
    *(.text.genwait_wait)
    *(.text.sndwav_thread.lto_priv.0)
    *(.text.thd_sleep)
    *(.text.pvr_wait_ready)
    *(.text.pvr_start_ta_rendering.part.0)
    *(.text.get_vmu_fn.lto_priv.0)
    *(.text.pvr_fog_far_depth)
    *(.text.g1_ata_blockdev_for_partition)
    *(.text.MiniLoop)
    *(.text.perf_cntr_timer_ns)
    *(.text.perf_cntr_timer_enabled)
    *(.text.pvr_scene_begin)
    *(.text.I_InitRumble.part.0)
    *(.text.A_Chase)
    *(.text.P_CheckMeleeRange)
    *(.text.pvr_txr_load)
    *(.text.pvr_sq_load)
    *(.text.__multiply)
    *(.text.cdrom_vblank)
    *libkallisti.a:matrix.o(.text)
    *(.text.elf_load)
    *(.text.samples_to_bytes)
    *(.text.snd_stream_poll)
    *(.text.bytes_to_samples)
    *(.text._tzset_unlocked_r)
    *(.text.P_MovePsprites.constprop.0)
    *(.text.P_SetPsprite)
    *(.text.A_WeaponReady)
    *(.text.A_Lower)
    *(.text.P_AddThinker)
    *(.text._fseeko_r)
    *(.text.vid_set_vram)
    *(.text.vid_set_start)
    *(.text.pvr_fog_table_color)
    *(.text.P_RemoveMobj)
    *(.text.IN_Start)
    *(.text.sq_cpy)
    *(.text.P_Random)
    *(.text.P_SpawnBlood)
    *(.text.P_SetMobjState)
    *(.text.A_PlayAttack)
    *(.text.A_PosAttack)
    *(.text.expm1f)
    *(.text.R_RenderSwitch.part.0)
    *(.text.R_AddProjectileLight)
    *(.text.vmufs_dir_read)
    *(.text.P_PointOnLineSide)
    *(.text.sci_dma_write_data)
    *(.text.ST_UpdateFlash)
    *(.text.A_FatRaise)
    *(.text.pvr_int_malloc)
    *(.text.pvr_int_sbrk)
    *(.text.T_Glow)
    *(.text.sci_dma_read_data)
    *(.text.P_SpawnMobj)
    *(.text.A_SpawnSmoke)
    *(.text.R_RenderEvilSky)
    *(.text.PTR_ShootTraverse)
    *(.text.P_LineOpening)
    *(.text.P_TryMove)
    *(.text.P_Move)
    *(.text.P_TryWalk)
    *(.text.P_NewChaseDir)
    *(.text.__pow5mult)
    *(.text.pvr_poly_cxt_txr)
    *(.text.P_Thrust)
    *(.text.T_CountdownTimer)
    *(.text.PTR_AimTraverse)
    *(.text.T_FireFlicker)
    *(.text.PTR_SlideTraverse)
    *(.text.A_Metal)
    *(.text.S_StartSound.isra.0)
    *(.text.S_SoundReverb)
    *(.text.S_WriteChannelSend.lto_priv.0)
    *(.text.M_SavePakTicker)
    *(.text.P_CheckCheats)
    *(.text.M_DrawBackground)
    *.ltrans4.ltrans.o(.text.fREe)
    *(.text.memalign)
    *(.text.mALLOc)
    *(.text.T_MoveCamera)
    *(.text.A_Pain)
    *(.text.scif_write_buffer)
    *(.text.scif_write)
    *(.text.scif_flush)
    *(.text.sh4fit_perf_restart)
    *(.text.perf_cntr_clear)
    *(.text.perf_cntr_stop)
    *(.text.A_FaceTarget)
    *(.text.A_TargetCamera)
    *(.text.snd_sfx_play_ex)
    *(.text.snd_sfx_play)
    *(.text.snd_init)
    *(.text.P_Drawer)
    *(.text.I_DrawFrame)
    *(.text.I_ClearFrame)
    *(.text.cond_wait)
    *(.text.W_ReadLump)
    *(.text.malloc)
    *(.text.net_ipv4_send)
    *(.text.P_LineAttack.constprop.0)
    *(.text.P_GiveAmmo)
    *(.text.P_RadiusAttack.constprop.0)
    *(.text.A_FadeAlpha)
    *(.text.A_Raise)
    *(.text.irq_dump_regs)
    *(.text.P_AimLineAttack)
    *(.text.PIT_UseLines)
    *(.text.P_DamageMobj)
    *(.text.PIT_RadiusAttack)
    *(.text.P_ExplodeMissile)
    *(.text.__newlib_lock_release_recursive)
    *(.text._fflush_r)
    *(.text.A_Explode)
    *(.text.L_MissileHit)
    *(.text.pty_write)
    *(.text.__sflush_r)
    *(.text.printf)
    *(.text.__sfvwrite_r)
    *(.text.__sprint_r)
    *(.text._vfprintf_r)
    *(.text.R_RenderPlayerView)
    *(.text.M_DrawOverlay)
    *(.text.R_SectorLightColor)
    *(.text.R_RenderWall)
    *(.text._strtoll_l.isra.0)
    *(.text.R_RenderPlane)
    *(.text.D_CreditTicker)
    *(.text.D_LegalTicker)
    *(.text.CheckTable)
    *(.text.get_monster)
    *(.text.G_CompleteLevel)
    *(.text.M_AlphaInStart)
    *(.text.M_AlphaOutStart)
    *(.text.M_AlphaInOutTicker)
    *(.text.sh4fit_window_report)
    *(.text.F_StartIntermission)
    *(.text.F_Start)
    *(.text.F_TickerIntermission)
    *(.text.I_VMUFBThread)
    *(.text.I_RumbleThread)
    *(.text.I_ParseMappingFile)
    *(.text.M_FadeOutStart)
    *(.text.aica_dsp_image_step)
    *(.text.masa_for.lto_priv.0)
    *(.text.emit.lto_priv.0)
    *(.text.term.lto_priv.0)
    *(.text.q15.lto_priv.0)
    *(.text.pos_set.lto_priv.0)
    *(.text.reg.lto_priv.0)
    *(.text.transform_vector.lto_priv.0.lto_priv.0)
    *(.text.perspdiv_vector.lto_priv.0.lto_priv.0)
    *(.text.draw_pvr_line)
    *(.text.AM_DrawLineThings)
    *(.text.AM_DrawThings)
    *(.text.M_Random)
    *(.text.M_FadeInStart)
    *(.text.ReadBinary.lto_priv.0)
    *(.text.StartDecodeByte.lto_priv.0)
    *(.text.G_InitSkill)
    *(.text.I_Rumble)
    *(.text.D_CreditDrawer)
    *(.text.D_DrawWarning)
    *(.text.D_DrawNoPak)
    *(.text.D_DrawLegal)
    *(.text.F_DrawerIntermission)
    *(.text.F_Drawer)
    *(.text.IN_Drawer)
    *(.text.__I_Error)
    *(.text.IN_Ticker)
    *(.text.M_MenuGameDrawer)
    *(.text.I_WIPE_FadeOutScreen)
    *(.text.F_StopIntermission)
    *(.text.F_Stop)
    *(.text.IN_Stop)
    *(.text.I_CheckControllerPak)
    *(.text.I_ReadPakFile)
    *(.text.M_ControllerPak)
    *(.text.M_AddToBox)
    *(.text.G_RunGame)
    *(.text.G_PlayDemoPtr)
    *(.text.I_Main)
    *(.text.M_BoxIntersect)
    *(.text.M_ButtonResponder)
    *(.text.M_SaveMenuData)
    *(.text.M_RestoreMenuData)
    *(.text.M_MenuClearCall)
    *(.text.M_LoadPakStart)
    *(.text.M_PasswordStart)
    *(.text.A_Fall)
    *(.text.PIT_PainCheckLine)
    *(.text.A_PainDeathEvent)
    *(.text.A_SkullSetAlpha)
    *(.text.A_MissileSetAlpha)
    *(.text.P_GiveWeapon)
    *(.text.P_GiveBody)
    *(.text.M_MenuTitleDrawer)
    *(.text.M_VolumeDrawer)
    *(.text.M_MovementDrawer)
    *(.text.M_VideoDrawer)
    *(.text.M_DisplayDrawer)
    *(.text.M_StatusHUDDrawer)
    *(.text.M_PasswordDrawer)
    *(.text.M_FeaturesDrawer)
    *(.text.M_CreditsDrawer)
    *(.text.M_ControlPadDrawer)
    *(.text.M_LoadPakDrawer)
    *(.text.M_SavePakStop)
    *(.text.A_XScream)
    *(.text.M_ControlPadTicker)
    *(.text.M_ControllerPakDrawer)
    *(.text.M_SavePakStart)
    *(.text.M_LoadPakTicker)
    *(.text.M_PasswordTicker)
    *(.text.A_CyberDeathEvent)
    *(.text.A_RectDeathEvent)
    *(.text.A_FadeOut)
    *(.text.A_FadeIn)
    *(.text.P_RemoveActiveCeiling)
    *(.text.T_LightMorph)
    *(.text.T_FadeThinker)
    *(.text.A_MoveGroundFire)
    *(.text.A_Scream)
    *(.text.T_Quake)
    *(.text.A_BspiFaceTarget)
    *(.text.A_SpidRefire)
    *(.text.A_RectMissile)
    *(.text.A_RectGroundFire)
    *(.text.T_AimCamera)
    *(.text.A_OnDeathTrigger)
    *(.text.A_BarrelExplode)
    *(.text.A_SPosAttack)
    *(.text.P_MissileAttack)
    *(.text.A_BspiAttack)
    *(.text.A_TroopAttack)
    *(.text.A_CyberAttack)
    *(.text.A_FatAttack1)
    *(.text.A_FatAttack2)
    *(.text.A_FatAttack3)
    *(.text.M_SavePakDrawer)
    *(.text.M_FadeOutStart.part.0)
    *(.text.M_ScreenTicker)
    *(.text.M_LoadPakStop)
    *(.text.M_PasswordStop)
    *(.text.Encode.lto_priv.0)
    *(.text.EV_DoCeiling)
    *(.text.EV_DoDoor)
    *(.text.EV_DoFloor)
    *(.text.EV_BuildStairs)
    *(.text.EV_SplitSector)
    *(.text.PIT_ChangeSector)
    *(.text.L_SkullBash)
    *(.text.P_SpawnGlowingLight)
    *(.text.P_SpawnStrobeFlash)
    *(.text.P_SpawnStrobeAltFlash)
    *(.text.P_ModifySectorColor)
    *(.text.P_UpdateLightThinker)
    *(.text.P_SuspendMacro)
    *(.text.P_ToggleMacros)
    *(.text.A_TroopMelee)
    *(.text.A_SargAttack)
    *(.text.A_HeadAttack)
    *(.text.A_BruisAttack)
    *(.text.A_Tracer)
    *(.text.A_RectTracer)
    *(.text.A_SkullAttack)
    *(.text.P_ChangeSector)
    *(.text.T_MoveFloor)
    *(.text.T_MoveCeiling)
    *(.text.T_MoveSplitPlane)
    *(.text.P_SetAimCamera)
    *(.text.P_SpawnDelayTimer)
    *(.text.P_ModifySector)
    *(.text.P_RefreshBrightness)
    *(.text.A_RectChase)
    *(.text.A_Hoof)
    *(.text.A_BabyMetal)
    *(.text.A_PainShootSkull)
    *(.text.A_PainAttack)
    *(.text.A_PainDie)
    *(.text.P_RecursiveSound)
    *(.text.A_BFGFlash)
    *(.text.A_BFGsound)
    *(.text.A_LoadShotgun2)
    *(.text.A_CloseShotgun2)
    *(.text.A_Punch)
    *(.text.A_Saw)
    *(.text.P_GunShot)
    *(.text.P_FlushSprites)
    *(.text.P_ChangeSwitchTexture)
    *(.text.P_LaserCrossBSP)
    *(.text.P_SpawnMapThing)
    *(.text.P_SpawnPuff)
    *(.text.P_CheckAmmo)
    *(.text.A_CheckReload)
    *(.text.P_FireWeapon)
    *(.text.A_ReFire)
    *(.text.A_ChainSawReady)
    *(.text.A_PlasmaReady)
    *(.text.A_GunFlash)
    *(.text.A_PlasmaAnimate)
    *(.text.P_StartElectricLoop)
    *(.text.P_StopElectricLoop)
    *(.text.P_SpawnPlayerMissile)
    *(.text.A_FireMissile)
    *(.text.A_FireBFG)
    *(.text.A_FirePlasma)
    *(.text.P_BulletSlope)
    *(.text.A_FirePistol)
    *(.text.A_FireShotgun)
    *(.text.A_FireShotgun2)
    *(.text.A_FireCGun)
    *(.text.A_BFGSpray)
    *(.text.P_FlushAllCached)
    *(.text.P_BringUpWeapon)
    *(.text.getNextSector)
    *(.text.P_FindLowestFloorSurrounding)
    *(.text.P_FindHighestFloorSurrounding)
    *(.text.P_FindNextHighestFloor)
    *(.text.P_FindLowestCeilingSurrounding)
    *(.text.P_FindSectorFromLineTag)
    *(.text.P_Telefrag)
    *(.text.EV_DoPlat)
    *(.text.A_FireLaser)
    *(.text.P_ActivateLineByTag)
    *(.text.T_MobjExplode)
    *(.text.P_RemoveActivePlat)
    *(.text.T_PlatRaise)
    *(.text.T_LaserThinker)
    *(.text.R_RenderVoidSky)
    *(.text.R_RenderClouds)
    *(.text.laser_triangle)
    *(.text.P_Start)
    *(.text.R_RenderSpaceSky)
    *(.text.R_RenderCloudSky)
    *(.text.R_RenderDoomE1Sky)
    *(.text.R_RenderFireSky)
    *(.text.R_InitSymbols)
    *(.text.irq_inside_int)
    *(.text.dbgio_dev_get)
    *(.text.dbgio_enable)
    *(.text.dbgio_disable)
    *(.text.dbgio_set_irq_usage)
    *(.text.dbgio_read)
    *(.text.dbgio_write)
    *(.text.dbgio_flush)
    *(.text.dbgio_write_buffer)
    *(.text.dbgio_read_buffer)
    *(.text.dbgio_write_buffer_xlat)
    *(.text.null_detected.lto_priv.0)
    *(.text.null_init.lto_priv.0)
    *(.text.null_shutdown)
    *(.text.null_set_irq_usage.lto_priv.0)
    *.ltrans4.ltrans.o(.text.null_write)
    *(.text.null_flush)
    *(.text.null_write_buffer)
    *(.text.fs_getwd)
    *(.text.irq_handle_trapa)
    *(.text.irq_def_fpu)
    *(.text.irq_set_context)
    *(.text.irq_get_context)
    *(.text.kbd_set_queue)
    *(.text.kbd_get_key)
    *(.text.maple_frame_unlock)
    *(.text.library_init)
    *(.text.mem_check_block)
    *(.text.mem_check_all)
    *(.text.valloc)
    *(.text.largebin_index)
    *(.text.maple_driver_reg)
    *(.text.kbd_init)
    *(.text.lightgun_init)
    *(.text.maple_driver_unreg)
    *(.text.kbd_shutdown)
    *(.text.lightgun_shutdown)
    *(.text.maple_perror)
    *(.text.maple_dev_valid)
    *(.text.maple_enum_count)
    *(.text.mmu_use_table)
    *(.text.map_virt)
    *(.text.mmu_virt_to_phys)
    *(.text.mmu_switch_context)
    *(.text.mmu_map_get_callback)
    *(.text.mmu_map_set_callback)
    *(.text.mouse_reply)
    *(.text.mouse_init)
    *(.text.mouse_shutdown)
    *(.text.dbgio_write_str)
    *(.text.maple_pcaps)
    *(.text.null_read.lto_priv.0.lto_priv.0)
    *(.text.null_read_buffer.lto_priv.0)
    *(.text.fs_path_append)
    *(.text.fs_get_handle)
    *(.text.fs_get_handler)
    *(.text.fs_map_hnd)
    *(.text.fs_read)
    *(.text.fs_write)
    *(.text.fs_seek)
    *(.text.wav_file_callback)
    *(.text.fs_seek64)
    *(.text.fs_tell)
    *(.text.fs_tell64)
    *(.text.fs_total)
    *(.text.fs_total64)
    *(.text.fs_mmap)
    *(.text.fs_complete)
    *(.text.fs_rewinddir)
    *(.text.fs_fstat)
    *(.text.mmu_shutdown)
    *(.text.irq_get_handler)
    *(.text.irq_set_global_handler)
    *(.text.irq_get_global_handler)
    *(.text.trapa_set_handler)
    *(.text.kbd_poll_intern)
    *(.text.mouse_poll)
    *(.text.dbgio_dev_select)
    *(.text.fs_ioctl)
    *(.text.fs_fcntl)
    *(.text.fs_normalize_path)
    *(.text.fs_readdir)
    *(.text.fs_verify_handler)
    *(.text.fs_rename)
    *(.text.fs_unlink)
    *(.text.fs_mkdir)
    *(.text.fs_rmdir)
    *(.text.fs_link)
    *(.text.fs_readlink)
    *(.text.fs_stat)
    *(.text.fs_chdir)
    *(.text.vmu_fs_init)
    *(.text.arch_exit)
    *(.text.irq_def_timer)
    *(.text.mmu_copyin)
    *(.text.kbd_reply)
    *(.text.mALLINFo)
    *(.text.mallinfo)
    *(.text.free)
    *(.text.fs_hnd_unref)
    *(.text.fs_close)
    *(.text.wav_destroy.part.0)
    *(.text.fs_dup2)
    *(.text.library_shutdown)
    *(.text.maple_driver_detach)
    *(.text.mmu_context_destroy)
    *(.text.mmu_context_create)
    *(.text.mmu_page_map)
    *(.text.realloc)
    *(.text.calloc)
    *(.text.fs_hnd_open)
    *(.text.maple_driver_attach)
    *(.text.mmu_copyv)
    *(.text.mmu_init)
    *(.text.S_RemoveOrigin)
    *(.text.S_ResetSound)
    *(.text.S_SetSoundVolume)
    *(.text.S_StopMusic)
    *(.text.ST_Message)
    *(.text.ST_DrawSymbol)
    *(.text.ST_DrawString)
    *(.text.ST_calcPainOffset)
    *(.text.ST_drawVMUFace)
    *(.text.W_DrawLoadScreen)
    *(.text.W_CheckNumForName)
    *(.text.W_GetMapLump)
    *(.text.Z_CheckZone)
    *(.text.Z_Defragment)
    *(.text.spinlock_lock.lto_priv.0.lto_priv.0)
    *(.text.cond_create)
    *(.text.fs_hnd_assign)
    *(.text.fs_open)
    *(.text.fs_copy)
    *(.text.fs_load)
    *(.text.fs_open_handle)
    *(.text.fs_dup)
    *(.text.vmu_fs_shutdown)
    *(.text.dcload_init)
    *(.text.arch_menu)
    *(.text.arch_abort)
    *(.text.arch_reboot)
    *(.text.kbd_attach)
    *(.text.malloc_stats)
    *(.text.maple_wait_scan)
    *(.text.maple_init)
    *(.text.maple_shutdown)
    *(.text.maple_raddr)
    *(.text.mutex_create)
    *(.text.dbgio_printf)
    *(.text.S_SetMusicVolume)
    *(.text.S_StartMusic)
    *(.text.itlb_pv)
    *(.text.dtlb_pv_read)
    *(.text.dtlb_pv_write)
    *(.text.initial_page_write)
    *(.text.g2_read_8)
    *(.text.g2_write_8)
    *(.text.g2_read_16)
    *(.text.g2_write_16)
    *(.text.g2_write_32)
    *(.text.g2_read_block_8)
    *(.text.g2_write_block_8)
    *(.text.g2_read_block_16)
    *(.text.g2_write_block_16)
    *(.text.g2_read_block_32)
    *(.text.g2_write_block_32)
    *(.text.cond_destroy)
    *(.text.cond_broadcast)
    *(.text.arch_shutdown)
    *(.text.mmu_gen_tlb_miss)
    *(.text.itlb_miss)
    *(.text.dtlb_miss_read)
    *(.text.dtlb_miss_write)
    *(.text.mutex_is_locked)
    *(.text.net_get_if_list)
    *(.text.nmmgr_get_list)
    *(.text.neg_exp)
    *(.text.pvr_fog_vertex_color)
    *(.text.pvr_fog_table_exp2)
    *(.text.pvr_fog_table_exp)
    *(.text.pvr_fog_table_custom)
    *(.text.asic_evt_enable)
    *(.text.asic_evt_disable)
    *(.text.pvr_set_bg_color)
    *(.text.pvr_get_vbl_count)
    *(.text.pvr_get_stats)
    *(.text.pvr_set_pal_format)
    *(.text.pvr_set_vertbuf)
    *(.text.pvr_list_flush)
    *(.text.thd_get_current)
    *(.text.pvr_check_ready)
    *(.text.rtc_boot_time)
    *(.text.scif_set_parameters)
    *(.text.scif_data_irq)
    *(.text.scif_detected)
    *(.text.scif_init_fake)
    *(.text.scif_init)
    *(.text.sip_reply)
    *(.text.sip_attach)
    *(.text.snd_stream_set_callback)
    *(.text.snd_stream_set_callback_direct)
    *(.text.snd_stream_reinit)
    *(.text.snd_stream_queue_enable)
    *(.text.snd_stream_queue_disable)
    *(.text.sq_wait)
    *(.text.thd_state_to_str)
    *(.text.thd_pslist_queue)
    *(.text.thd_by_tid)
    *(.text.thd_idle_task.lto_priv.0)
    *(.text.thd_set_prio)
    *(.text.thd_get_label)
    *(.text.thd_get_pwd)
    *(.text.thd_get_errno)
    *(.text.timer_count)
    *(.text.timer_ints_enabled)
    *(.text.timer_ms_handler.lto_priv.0)
    *(.text.timer_primary_set_callback)
    *(.text.vid_check_cable)
    *(.text.vid_get_start)
    *(.text.vid_set_fb)
    *(.text.vid_flip)
    *(.text.vid_border_color)
    *(.text.vid_get_enabled)
    *(.text.vid_set_enabled)
    *(.text.vid_waitvbl)
    *(.text.vmu_pkg_crc)
    *(.text.vmu_attach)
    *(.text.dec_to_bcd)
    *(.text.vmufs_dir_blocks)
    *(.text.vmufs_fat_blocks)
    *(.text.vmufs_fat_free)
    *(.text.vmufs_dir_free)
    *(.text.asic_evt_set_handler)
    *(.text.asic_evt_disable_all)
    *(.text.snd_stream_filter_remove)
    *(.text.scif_read)
    *(.text.scif_read_buffer)
    *(.text.mutex_destroy)
    *(.text.snd_sfx_chn_alloc)
    *(.text.snd_sfx_chn_free)
    *(.text.vblank_handler_remove)
    *(.text.thd_worker_thread.lto_priv.0)
    *(.text.net_reg_device)
    *(.text.net_unreg_device)
    *(.text.thd_set_mode)
    *(.text.vid_set_mode_ex)
    *(.text.vmu_pkg_parse)
    *(.text.vmufs_dir_add)
    *(.text.vmufs_find_block)
    *(.text.pvr_mem_reset)
    *(.text.pvr_poly_cxt_col)
    *(.text.snd_stream_filter_add)
    *(.text.vblank_handler_add)
    *(.text.net_ndp_send_sol)
    *(.text.kos_shutdown)
    *(.text.nmmgr_lookup)
    *(.text.arch_panic)
    *(.text.purupuru_rumble_cb.lto_priv.0)
    *(.text.vmu_gen_callback)
    *(.text.vmu_block_read_callback)
    *(.text.vmu_block_write_callback)
    *(.text.purupuru_init)
    *(.text.sip_init)
    *(.text.vmu_init)
    *(.text.purupuru_shutdown)
    *(.text.sip_shutdown)
    *(.text.vmu_shutdown)
    *(.text.dma_done.lto_priv.0)
    *(.text.pvr_mem_malloc)
    *(.text.pvr_mem_free)
    *(.text.scif_err_irq)
    *(.text.rtc_unix_secs)
    *(.text.snd_get_pos)
    *(.text.snd_is_playing)
    *(.text.scif_set_irq_usage)
    *(.text.scif_shutdown)
    *(.text.sip_poll)
    *(.text.vmu_draw_lcd)
    *(.text.spu_cdda_volume)
    *(.text.spu_cdda_pan)
    *(.text.spu_master_mixer)
    *(.text.snd_mem_shutdown)
    *(.text.snd_mem_init)
    *(.text.snd_stream_alloc)
    *(.text.snd_mem_free)
    *(.text.snd_sfx_unload_all)
    *(.text.snd_sfx_unload)
    *(.text.snd_mem_available)
    *(.text.vmufs_dir_find)
    *(.text.vmufs_file_delete)
    *(.text.spu_memload)
    *(.text.spu_memset)
    *(.text.spu_memread)
    *(.text.spu_dma_transfer)
    *(.text.dma_chain)
    *(.text.arch_stk_trace)
    *(.text.arch_stk_trace_at)
    *(.text.thd_exit)
    *(.text.thd_birth)
    *(.text.vmu_pkg_build)
    *(.text.thd_set_label)
    *(.text.thd_set_pwd)
    *(.text.thd_destroy)
    *(.text.thd_reaper.lto_priv.0)
    *(.text.thd_join)
    *(.text.timer_prime)
    *(.text.timer_spin_sleep)
    *(.text.vmu_set_icon)
    *(.text.vmu_block_read)
    *(.text.vmufs_root_read)
    *(.text.vmufs_file_read)
    *(.text.vmufs_read_common)
    *(.text.vmu_block_write)
    *(.text.vmufs_root_write)
    *(.text.vmufs_dir_write)
    *(.text.vmufs_file_write)
    *(.text.vmufs_dir_fill_time)
    *(.text.vmufs_fat_read)
    *(.text.vmufs_fat_write)
    *(.text.cdrom_set_sector_size)
    *(.text.snd_sfx_stop)
    *(.text.snd_sfx_stop_all)
    *(.text.snd_aica_to_sh4)
    *(.text.snd_poll_resp)
    *(.text.spu_reset_chans)
    *(.text.spu_enable)
    *(.text.spu_disable)
    *(.text.snd_shutdown)
    *(.text.snd_sh4_to_aica_start)
    *(.text.snd_stream_queue_go)
    *(.text.snd_stream_transfer)
    *(.text.vmufs_mutex_unlock)
    *(.text.vmufs_teardown)
    *(.text.net_ipv4_checksum)
    *(.text._exit)
    *(.text.pvr_sprite_compile)
    *(.text.syscall_gdrom_init)
    *(.text.syscall_gdrom_exec_server)
    *(.text.cdrom_submit_cmd.lto_priv.0)
    *(.text.cdrom_check_ready.lto_priv.0)
    *(.text.cdrom_check_cmd_done.lto_priv.0)
    *(.text.cdrom_check_abort_done.lto_priv.0)
    *(.text.thd_create_ex)
    *(.text.thd_create)
    *(.text.timer_ms_gettime)
    *(.text.nmmgr_handler_remove)
    *(.text.pvr_mem_stats)
    *(.text.nmmgr_handler_add)
    *(.text.pvr_txr_load_kimg)
    *(.text.snd_sh4_to_aica_stop)
    *(.text.snd_stream_stop)
    *(.text.snd_stream_volume)
    *(.text.snd_stream_pan)
    *(.text.snd_sfx_play_chn)
    *(.text.snd_stream_destroy)
    *(.text.snd_stream_shutdown)
    *(.text.snd_pcm16_split_sq)
    *(.text.spu_memload_sq)
    *(.text.create_snd_effect)
    *(.text.snd_sfx_load)
    *(.text.snd_sfx_load_buf)
    *(.text.snd_sfx_load_fd)
    *(.text.snd_sfx_load_ex)
    *(.text.spu_memload_dma)
    *(.text.spu_memset_sq)
    *(.text.snd_stream_init_ex)
    *(.text.snd_stream_init)
    *(.text.snd_stream_fill)
    *(.text.snd_stream_start_type)
    *(.text.snd_stream_start)
    *(.text.snd_stream_start_pcm8)
    *(.text.snd_stream_start_adpcm)
    *(.text.sq_set)
    *(.text.sq_set16)
    *(.text.sq_clr)
    *(.text.vid_empty)
    *(.text.vid_init)
    *(.text.vid_shutdown)
    *(.text.vid_clear)
    *(.text.vmufs_mutex_lock)
    *(.text.vmufs_setup)
    *(.text.vmufs_readdir)
    *(.text.vmufs_read)
    *(.text.vmufs_read_dirent)
    *(.text.vmufs_write)
    *(.text.vmufs_delete)
    *(.text.vmufs_free_blocks)
    *(.text.net_ndp_gc)
    *(.text.timer_us_gettime64)
    *(.text.net_ipv4_input_proto)
    *(.text.net_ipv4_input)
    *(.text.net_ipv4_send_packet)
    *(.text.net_ipv4_frag_send)
    *(.text.net_ipv6_send_packet)
    *(.text.pvr_scene_begin_txr)
    *(.text.thd_pslist)
    *(.text.thd_schedule_next)
    *(.text.ubc_wait.lto_priv.0)
    *(.text.disable_breakpoint.lto_priv.0)
    *(.text.handle_exception.lto_priv.0)
    *(.text.ubc_shutdown)
    *(.text.wdt_disable)
    *(.text.thd_worker_wakeup)
    *(.text.asic_thirq_dispatch)
    *(.text.thd_worker_destroy)
    *(.text.asic_evt_remove_handler)
    *(.text.pvr_shutdown)
    *(.text.cdrom_stream_progress)
    *(.text.cdrom_stream_set_callback)
    *(.text.cdrom_locate_data_track)
    *(.text.cont_btn_cb_thread)
    *(.text.dreameye_poll)
    *(.text.dreameye_attach)
    *(.text.fb_detected)
    *(.text.fb_init.lto_priv.0)
    *(.text.fb_shutdown)
    *(.text.fb_set_irq_usage)
    *(.text.fb_flush)
    *(.text.hnd_is_dir)
    *(.text.never_detected)
    *(.text.fs_dcload_detected)
    *(.text.dcls_detected.lto_priv.0)
    *(.text.dcls_fake_init)
    *(.text.dcls_fake_shutdown)
    *(.text.bgrad_cache)
    *(.text.romdisk_close)
    *(.text.fs_socket_read.lto_priv.0)
    *(.text.fs_socket_write.lto_priv.0)
    *(.text.fs_socket_fcntl.lto_priv.0)
    *(.text.fs_socket_poll.lto_priv.0)
    *(.text.net_input)
    *(.text.net_input_set_target)
    *(.text.pvr_dma_ready)
    *(.text.rnd_unlink)
    *(.text.elf_free)
    *(.text.vmu_pkg_dup)
    *(.text.dev_stat)
    *(.text.null_stat)
    *(.text.rnd_stat)
    *(.text.fs_socket_fstat.lto_priv.0)
    *(.text.bclear_cache)
    *(.text.null_verify_hnd)
    *(.text.null_seek)
    *(.text.null_tell)
    *(.text.null_total)
    *(.text.rnd_verify_hnd)
    *(.text.rnd_write)
    *(.text.rnd_seek)
    *(.text.rnd_tell)
    *(.text.rnd_total)
    *(.text.vmu_verify_hnd)
    *(.text.vmu_read.lto_priv.0)
    *(.text.vmu_mmap.lto_priv.0)
    *(.text.vmu_seek.lto_priv.0)
    *(.text.vmu_tell.lto_priv.0)
    *(.text.vmu_total.lto_priv.0)
    *(.text.export_init)
    *(.text.fs_dev_init)
    *(.text.fs_dev_shutdown)
    *(.text.fs_null_shutdown)
    *(.text.fs_ramdisk_shutdown)
    *(.text.fs_rnd_shutdown)
    *(.text.fs_romdisk_shutdown)
    *(.text.icmp_default_echo_cb.lto_priv.0)
    *(.text.vmu_write.lto_priv.0)
    *(.text.g2_dma_irq_hnd.lto_priv.0)
    *(.text.fb_write.lto_priv.0)
    *(.text.fb_write_buffer.lto_priv.0)
    *(.text.cont_init)
    *(.text.dreameye_init)
    *(.text.dreameye_shutdown)
    *(.text.vmu_path_to_addr)
    *(.text.pvr_sq_set16)
    *(.text.fs_iso9660_shutdown)
    *(.text.vmu_unlink.lto_priv.0)
    *(.text.cdrom_check_abort_streaming)
    *(.text.cdrom_check_transfer)
    *(.text.iso_close)
    *(.text.ramdisk_close)
    *(.text.ramdisk_read)
    *(.text.ramdisk_write)
    *(.text.ramdisk_tell)
    *(.text.ramdisk_total)
    *(.text.ramdisk_mmap)
    *(.text.cdrom_stream_request)
    *(.text.cdrom_abort_cmd)
    *(.text.cdrom_exec_cmd_timed)
    *(.text.cdrom_exec_cmd)
    *(.text.cdrom_read_toc)
    *(.text.cdrom_read_sectors_ex)
    *(.text.cdrom_read_sectors)
    *(.text.cdrom_get_subcode)
    *(.text.cdrom_cdda_play)
    *(.text.cdrom_cdda_pause)
    *(.text.cdrom_cdda_resume)
    *(.text.cdrom_spin_down)
    *(.text.cdrom_stream_stop)
    *(.text.cdrom_stream_start)
    *(.text.pty_destroy_unused)
    *(.text.pty_close)
    *(.text.fs_pty_shutdown)
    *(.text.fs_socket_close.lto_priv.0)
    *(.text.cdrom_change_datatype)
    *(.text.cdrom_reinit_ex)
    *(.text.cdrom_reinit)
    *(.text.cdrom_init)
    *.ltrans6.ltrans.o(.text.g1_dma_irq_hnd)
    *(.text.cdrom_shutdown)
    *(.text.cont_btn_callback_del)
    *(.text.cont_shutdown)
    *(.text.cont_btn_callback)
    *(.text.find_sym)
    *(.text.fb_read)
    *(.text.fb_read_buffer)
    *(.text.dcload_fcntl.lto_priv.0)
    *(.text.dcls_fcntl)
    *(.text.dev_readdir)
    *(.text.dev_open)
    *(.text.dev_rewinddir.part.0)
    *(.text.vmu_rewinddir.lto_priv.0)
    *(.text.romdisk_rewinddir)
    *(.text.rnd_close)
    *(.text.rnd_fstat)
    *(.text.pty_fstat)
    *(.text.pty_rewinddir)
    *(.text.null_close)
    *(.text.null_read.lto_priv.1)
    *(.text.null_fstat)
    *(.text.iso_tell)
    *(.text.iso_rewinddir)
    *(.text.dev_close)
    *(.text.dev_rewinddir)
    *(.text.iso_seek)
    *(.text.iso_total)
    *(.text.iso_fcntl)
    *(.text.iso_fstat)
    *(.text.null_open)
    *.ltrans6.ltrans.o(.text.null_write)
    *(.text.pty_read)
    *(.text.pty_total)
    *(.text.pty_readdir)
    *(.text.pty_fcntl)
    *(.text.ramdisk_seek)
    *(.text.ramdisk_readdir)
    *(.text.ramdisk_fcntl)
    *(.text.ramdisk_rewinddir)
    *(.text.ramdisk_fstat)
    *(.text.rnd_open)
    *(.text.rnd_fcntl)
    *(.text.romdisk_read)
    *(.text.romdisk_write)
    *(.text.romdisk_seek)
    *(.text.romdisk_tell)
    *(.text.romdisk_total)
    *(.text.romdisk_unlink)
    *(.text.romdisk_mmap)
    *(.text.romdisk_fcntl)
    *(.text.romdisk_fstat)
    *(.text.fs_romdisk_mount)
    *(.text.fs_romdisk_unmount)
    *(.text.fs_socket_seek.lto_priv.0)
    *(.text.fs_socket_tell.lto_priv.0)
    *(.text.vmu_close.lto_priv.0)
    *(.text.vmu_ioctl.lto_priv.0)
    *(.text.vmu_stat.lto_priv.0)
    *(.text.vmu_fcntl.lto_priv.0)
    *(.text.vmu_fstat.lto_priv.0)
    *(.text.fs_dcload_init_console)
    *(.text.fs_dcload_shutdown)
    *(.text.dcls_recv_loop)
    *(.text.dcls_rename)
    *(.text.dcls_unlink)
    *(.text.dcls_close)
    *(.text.dcls_read)
    *(.text.dcls_write)
    *(.text.dcls_seek)
    *(.text.dcls_tell)
    *(.text.dcls_total)
    *(.text.dcls_stat)
    *(.text.dcls_writebuf.lto_priv.0)
    *(.text.dcls_open)
    *(.text.dcls_readdir)
    *(.text.fs_dclsocket_shutdown)
    *(.text.vmu_open.lto_priv.0)
    *(.text.vmu_readdir.lto_priv.0)
    *(.text.fs_iso9660_init)
    *(.text.fs_null_init)
    *(.text.fs_pty_create)
    *(.text.fs_pty_init)
    *(.text.fs_rnd_init)
    *(.text.fs_romdisk_init)
    *(.text.pty_open)
    *(.text.pty_stat)
    *(.text.ramdisk_find_path)
    *(.text.ramdisk_unlink)
    *(.text.fs_ramdisk_init)
    *(.text.ramdisk_open)
    *(.text.rnd_read)
    *(.text.icmp6_default_echo_cb.lto_priv.0)
    *(.text.net_default_input)
    *(.text.pvr_txr_load_dma)
    *(.text.pvr_dma_yuv_conv)
    *(.text.dcload_write_buffer)
    *(.text.dcload_open.lto_priv.0)
    *(.text.dcload_close.lto_priv.0)
    *(.text.dcload_read.lto_priv.0)
    *(.text.dcload_write.lto_priv.0)
    *(.text.dcload_seek.lto_priv.0)
    *(.text.dcload_tell.lto_priv.0)
    *(.text.dcload_total.lto_priv.0)
    *(.text.dcload_readdir.lto_priv.0)
    *(.text.dcload_rename.lto_priv.0)
    *(.text.dcload_unlink.lto_priv.0)
    *(.text.dcload_stat.lto_priv.0)
    *(.text.dcload_rewinddir.lto_priv.0)
    *(.text.htohl_32.lto_priv.0)
    *(.text.init_percd)
    *(.text.bread_cache)
    *(.text.iso_open)
    *(.text.iso_readdir)
    *(.text.iso_stat)
    *(.text.find_object.lto_priv.0)
    *(.text.ntohl_32.lto_priv.0)
    *(.text.romdisk_find)
    *(.text.romdisk_open)
    *(.text.romdisk_readdir)
    *(.text.romdisk_stat)
    *(.text.fs_socket_input)
    *(.text.sem_count)
    *(.text.__assert)
    *(.text.bits_per_pixel)
    *(.text.bfont_set_encoding)
    *(.text.bfont_set_foreground_color)
    *(.text.bfont_set_background_color)
    *(.text.bfont_draw_one_row)
    *(.text.g1_dma_in_progress)
    *(.text.g1_ata_set_sector_and_count)
    *(.text.g1_ata_wait_drq)
    *(.text.atab_count_blocks)
    *(.text.sci_shutdown_spi_cs)
    *(.text.sci_spi_set_cs)
    *(.text.scif_spi_shutdown)
    *(.text.scif_spi_set_cs)
    *(.text.scif_spi_rw_byte)
    *(.text.scif_spi_read_byte)
    *(.text.scif_spi_read_data)
    *(.text.scif_shutdown_wrapper)
    *(.text.scif_set_cs_wrapper)
    *(.text.sd_send_cmd)
    *(.text.acmd41_loop)
    *(.text.sd_shutdown)
    *(.text.sdb_count_blocks)
    *(.text.sdb_flush)
    *(.text.net_crc16ccitt.constprop.0)
    *(.text.read_data)
    *(.text.write_data.constprop.0)
    *(.text.sci_write_byte)
    *(.text.sci_read_byte)
    *(.text.sci_write_data)
    *(.text.sci_read_data)
    *(.text.scif_spi_init)
    *(.text.scif_init_wrapper)
    *.ltrans7.ltrans.o(.text.fREe)
    *(.text.g1_ata_lba_mode)
    *(.text.atab_init)
    *(.text.inet_ntop4)
    *(.text.sd_init_ex)
    *(.text.sd_init)
    *(.text.sd_read_blocks)
    *(.text.sdb_read_blocks)
    *(.text.sd_write_blocks)
    *(.text.sdb_write_blocks)
    *(.text.sd_get_size)
    *(.text.sdb_init)
    *(.text.sem_create)
    *(.text.atab_shutdown)
    *(.text.sci_shutdown)
    *(.text.sci_shutdown_wrapper)
    *(.text.sdb_shutdown)
    *(.text.sem_destroy)
    *(.text.sem_wait_timed)
    *(.text.sem_wait)
    *(.text.dma_common)
    *(.text.sem_trywait)
    *(.text.sem_signal)
    *(.text.sci_dma_wait_complete)
    *(.text.flashrom_info)
    *(.text.flashrom_read)
    *(.text.flashrom_write)
    *(.text.flashrom_delete)
    *(.text.vid_screen_shot_data)
    *(.text.assert_handler_default)
    *(.text.get_font_address)
    *(.text.bfont_find_char)
    *(.text.bfont_find_char_jp)
    *(.text.bfont_find_char_jp_half)
    *(.text.bfont_find_icon)
    *(.text.g1_ata_select_device)
    *(.text.g1_ata_mutex_unlock)
    *(.text.bfont_draw_ex)
    *(.text.bfont_draw_thin)
    *(.text.bfont_draw)
    *(.text.bfont_draw_wide)
    *(.text.bfont_draw_str_ex)
    *(.text.bfont_draw_str)
    *(.text.bfont_draw_str_ex_vfmt)
    *(.text.bfont_draw_str_vram_vfmt)
    *(.text.bfont_draw_str_ex_fmt)
    *(.text.bfont_draw_str_fmt)
    *(.text.bfont_draw_str_vram_fmt)
    *(.text.dma_irq_handler)
    *(.text.dma_transfer_abort)
    *(.text.arch_exec_at)
    *(.text.arch_exec)
    *(.text.flashrom_get_syscfg)
    *(.text.flashrom_get_region)
    *(.text.g1_ata_mutex_lock)
    *(.text.g1_ata_read_chs)
    *(.text.atab_read_blocks_chs)
    *(.text.g1_ata_write_chs)
    *(.text.atab_write_blocks_chs)
    *(.text.g1_ata_read_lba)
    *(.text.atab_read_blocks)
    *(.text.g1_ata_read_lba_dma)
    *(.text.atab_read_blocks_dma)
    *(.text.g1_ata_write_lba)
    *(.text.atab_write_blocks)
    *(.text.g1_ata_write_lba_dma)
    *(.text.atab_write_blocks_dma)
    *(.text.g1_dma_done)
    *.ltrans7.ltrans.o(.text.g1_dma_irq_hnd)
    *(.text.g1_ata_flush)
    *(.text.atab_flush)
    *(.text.g1_ata_set_transfer_mode)
    *(.text.g1_ata_scan)
    *(.text.g1_ata_blockdev_for_device)
    *(.text.sd_blockdev_for_partition)
    *(.text.sd_blockdev_for_device)
    *(.text.g1_ata_init)
    *(.text.g1_ata_shutdown)
    *(.text.mat_translate)
    *(.text.mat_scale)
    *(.text.mat_rotate_x)
    *(.text.mat_rotate_y)
    *(.text.mat_rotate_z)
    *(.text.mat_rotate)
    *(.text.mat_perspective)
    *(.text.sci_configure_uart)
    *(.text.sci_configure_spi)
    *(.text.sci_init)
    *(.text.sci_init_wrapper)
    *(.text.vid_screen_shot)
    *(.text.timer_spin_delay_ns.constprop.0)
    *(.text.sci_spi_rw_byte)
    *(.text.sci_rw_byte)
    *(.text.sci_spi_rw_data)
    *(.text.sci_spi_write_byte)
    *(.text.sci_write_byte_wrapper)
    *(.text.sci_spi_read_byte)
    *(.text.sci_read_byte_wrapper)
    *(.text.sci_spi_write_data)
    *(.text.sci_spi_read_data)
    *(.text.scif_spi_slow_rw_byte)
    *(.text.scif_rw_byte_wrapper)
    *(.text.mat_lookat)
    *(.text.pvr_int_free)
    *(.text.__assert_func)
    *(.text.sci_spi_dma_write_data)
    *(.text.sci_spi_dma_read_data)
    *(.text.sci_read_data_wrapper)
    *(.text.__newlib_lock_acquire)
    *(.text.__newlib_lock_release)
    *(.text.__newlib_lock_init_recursive)
    *(.text.__newlib_lock_acquire_recursive)
    *(.text._close_r)
    *(.text._fcntl_r)
    *(.text._fstat_r)
    *(.text._getentropy_r)
    *(.text._getpid_r)
    *(.text._gettimeofday_r)
    *(.text._isatty_r)
    *(.text._kill_r)
    *(.text._lseek_r)
    *(.text._free_r)
    *(.text._malloc_r)
    *(.text._calloc_r)
    *(.text._realloc_r)
    *(.text._memalign_r)
    *(.text._open_r)
    *(.text._read_r)
    *(.text._sbrk_r)
    *(.text._write_r)
    *(.text.find_object_path.constprop.0)
    *(.text.recv.constprop.0)
    *(.text.syscall_gdrom_check_command.constprop.0)
    *(.text.net_ipv6_send.constprop.0)
    *(.text.inet_ntop6.constprop.0)
    *(.text.net_ipv6_checksum_pseudo.constprop.0)
    *(.text.net_icmp6_send_param_prob.constprop.0)
    *(.text.P_StartButton.constprop.0)
    *(.text.ST_DrawNumber.constprop.0)
    *(.text.vmufb_paint_area_strided.constprop.0)
    *(.text.vmufb_paint_xbm.constprop.0)
    *(.text.thd_worker_create_ex.constprop.0)
    *(.text.MD5Update.constprop.0)
    *(.text.MD5Final.constprop.0)
    *(.text.draw_pvr_line_hdr.constprop.0)
    *(.text.update_map.constprop.0)
    *(.text.W_CacheLumpName.constprop.0)
    *(.text.M_DecodePassword.constprop.0)
    *(.text.malloc_consolidate.constprop.0)
    *(.text.spinlock_lock_irqsafe.constprop.0)
    *(.text.malloc_consolidate.constprop.1)
    *(.text.hashtable_insert.constprop.0.isra.0)
    *(.text.hashtable_init.constprop.0.isra.0)
    *(.text.I_SavePakSettings.constprop.0.isra.0)
    *(.text.mmu_page_map_static.constprop.0.isra.0)
    *(.text.net_icmp6_send_nsol.constprop.0.isra.0)
    *(.text.send.constprop.0.isra.0)
    *(.text.net_arp_query.isra.0)
    *(.text.net_arp_gc.isra.0)
    *(.text.net_arp_insert.isra.0)
    *(.text.romdisk_find_object.isra.0)
    *(.text.ramdisk_find.isra.0)
    *(.text.__mutex_scoped_cleanup.isra.0)
    *(.text.vmufs_fat_ops.isra.0)
    *(.text.snd_sh4_to_aica_ex.isra.0)
    *(.text.net_ndp_insert.isra.0)
    *(.text.frag_import.isra.0)
    *(.text.unhandled_mmu.isra.0)
    *(.text.vbl_chk_disconnect.isra.0)
    *(.text.kbd_enqueue.isra.0)
    *(.text.Z_FreeTags.constprop.0)
    *(.text.G_InitNew.constprop.0)
    *(.text.Z_Alloc2.constprop.0)
    *(.text.D_RunDemo.constprop.0)
    *(.text.EV_Teleport.isra.0)
    *libkallisti.a:itlb.o(.text)
    *libkallisti.a:math.o(.text)
    *libkallisti.a:snd_pcm_split.o(.text)
    *libkallisti.a:dcload-syscall.o(.text)
    *libkallisti.a:execasm.o(.text)
    *libkallisti.a:syscall_font.o(.text)
    *(.text.unlikely.abort)
    *(.text.log10)
    *(.text.floor)
    *(.text.nan)
    *(.text.__ieee754_log10)
    *(.text.with_errnof)
    *(.text.xflowf)
    *(.text.__math_oflowf)
    *(.text.__ieee754_log)
    *(.text._fseek_r)
    *(.text.fseek)
    *(.text.ftell)
    *(.text.rand)
    *(.text._strtol_l.part.0)
    *(.text._strtol_r)
    *(.text.strtol)
    *(.text.rewind)
    *(.text._fclose_r)
    *(.text.fclose)
    *(.text._fdopen_r)
    *(.text.fdopen)
    *(.text.fflush)
    *(.text.__sread)
    *(.text.__seofread)
    *(.text.__swrite)
    *(.text.__sseek)
    *(.text.__sclose)
    *(.text.stdio_exit_handler)
    *(.text.cleanup_stdio)
    *(.text.global_stdio_init.part.0)
    *(.text.__sfp)
    *(.text.__sinit)
    *(.text.__sfp_lock_acquire)
    *(.text.__sfp_lock_release)
    *(.text.__sflags)
    *(.text._fopen_r)
    *(.text.fopen)
    *(.text._fread_r)
    *(.text.fread)
    *(.text._ftello_r)
    *(.text.strtok)
    *(.text.__strtok_r)
    *(.text.strtok_r)
    *(.text.localtime_r)
    *(.text.time)
    *(.text.__tz_lock)
    *(.text.__tz_unlock)
    *(.text._tzset_unlocked)
    *(.text.chacha_keysetup.constprop.0)
    *(.text._rs_stir)
    *(.text.arc4random_buf)
    *(.text._reclaim_reent)
    *(.text.__errno)
    *libc.a:libc_a-strcpy.o(.text)
    *libc.a:libc_a-strcmp.o(.text)
    *(.text.close)
    *(.text.getentropy)
    *(.text.sbrk)
    *(.text._findenv_r)
    *(.text._getenv_r)
    *(.text.siscanf)
    *(.text._sungetc_r)
    *(.text.__ssrefill_r)
    *(.text._sfread_r)
    *(.text._fwalk_sglue)
    *(.text.__smakebuf_r)
    *(.text._strtoul_l.isra.0)
    *(.text._strtoul_r)
    *(.text.strtoul)
    *(.text.lflush)
    *(.text.__srefill_r)
    *(.text.__sccl)
    *(.text.__submore)
    *(.text.explicit_bzero)
    *(.text.strncmp)
    *(.text.raise)
    *(.text.__gettzinfo)
    *(.text.gmtime_r)
    *(.text.__locale_mb_cur_max)
    *(.text._strtoll_r)
    *(.text._strtoull_r)
    *(.text._mbrtowc_r)
    *(.text.iswspace)
    *(.text.iswspace_l)
    *(.text.__env_lock)
    *(.text.__env_unlock)
    *(.text.__ascii_mbtowc)
    *(.text.__ascii_wctomb)
    *(.text.bzero)
    *(.text.abs)
    *(.text.aligned_alloc)
    *(.text.exit)
    *(.text._fwrite_r)
    *(.text.fwrite)
    *(.text.puts)
    *(.text.snprintf)
    *(.text.sprintf)
    *(.text.sscanf)
    *(.text.fprintf)
    *(.text.fputc)
    *(.text.vsnprintf)
    *(.text.vsprintf)
    *(.text.memmove)
    *(.text.strcasecmp)
    *(.text.strcat)
    *(.text.strchr)
    *(.text.strdup)
    *(.text._strdup_r)
    *(.text.strncasecmp)
    *(.text.strncat)
    *(.text.strrchr)
    *(.text.__call_exitprocs)
    *(.text.__sbprintf)
    *(.text._putc_r)
    *(.text.sulp)
    *(.text._strtod_r)
    *(.text.__ssprint_r)
    *(.text.__swbuf_r)
    *(.text.__swsetup_r)
    *(.text.memchr)
    *(.text._localeconv_r)
    *(.text.nanf)
    *(.text.frexp)
    *(.text.quorem)
    *(.text.rshift)
    *(.text.__match)
    *(.text.__hexnan)
    *(.text._Balloc)
    *(.text._Bfree)
    *(.text.__multadd)
    *(.text.__s2b)
    *(.text.__hi0bits)
    *(.text.__lo0bits)
    *(.text.__i2b)
    *(.text.__lshift)
    *(.text.__mcmp)
    *(.text.__mdiff)
    *(.text.__ulp)
    *(.text.__b2d)
    *(.text.__d2b)
    *(.text.__ratio)
    *(.text.__copybits)
    *(.text.__any_on)
    *(.text.__ssputs_r)
    *libgcc.a:_set_fpscr.o(.text)
    *libgcc.a:_moddi3.o(.text)
    *libgcc.a:_udivdi3.o(.text)
    *libgcc.a:_umoddi3.o(.text)
    *libgcc.a:_unord_df.o(.text)
    *libgcc.a:_udiv_qrnnd_16.o(.text)
    *libgcc.a:_unpack_df.o(.text)
    *libgcc.a:_movmem_i4.o(.text)
    *libgcc.a:_ashldi3.o(.text)
    *libgcc.a:_ffssi2.o(.text)
    *libgcc.a:_fixdfdi.o(.text)
    *libgcc.a:_fixunsdfdi.o(.text)
    *libgcc.a:_floatdidf.o(.text)
    *libgcc.a:_floatundisf.o(.text)
    *libgcc.a:_floatundidf.o(.text)
    *(.text.gettimeofday)
    *crtend.o(.text)
    *(.text .stub .text.* .gnu.linkonce.t.*)
    . = MAX(., 0x5ded8);  /* Sh4Fit: keeps what follows this region in place */
    /* .gnu.warning sections are handled specially by elf32.em.  */
    *(.gnu.warning)
  } =0

  /* Custom sections, aligned to the icache size */
  .sub0 : ALIGN(8192) {
    *(.sub0*)
  }
  .sub1 : ALIGN(8192) {
    *(.sub1*)
  }
  .sub2 : ALIGN(8192) {
    *(.sub2*)
  }
  .sub3 : ALIGN(8192) {
    *(.sub3*)
  }
  .sub4 : ALIGN(8192) {
    *(.sub4*)
  }
  .sub5 : ALIGN(8192) {
    *(.sub5*)
  }
  .sub6 : ALIGN(8192) {
    *(.sub6*)
  }
  .sub7 : ALIGN(8192) {
    *(.sub7*)
  }
  .sub8 : ALIGN(8192) {
    *(.sub8*)
  }
  .sub9 : ALIGN(8192) {
    *(.sub9*)
  }

  .init           :
  {
    KEEP (*(.init))
  } =0
  .fini           :
  {
    KEEP (*(.fini))
  } =0
  .interp         : { *(.interp) }
  .note.gnu.build-id : { *(.note.gnu.build-id) }
  .hash           : { *(.hash) }
  .gnu.hash       : { *(.gnu.hash) }
  .dynsym         : { *(.dynsym) }
  .dynstr         : { *(.dynstr) }
  .gnu.version    : { *(.gnu.version) }
  .gnu.version_d  : { *(.gnu.version_d) }
  .gnu.version_r  : { *(.gnu.version_r) }
  .rel.dyn        :
    {
      *(.rel.init)
      *(.rel.text .rel.text.* .rel.gnu.linkonce.t.*)
      *(.rel.fini)
      *(.rel.rodata .rel.rodata.* .rel.gnu.linkonce.r.*)
      *(.rel.data.rel.ro* .rel.gnu.linkonce.d.rel.ro.*)
      *(.rel.data .rel.data.* .rel.gnu.linkonce.d.*)
      *(.rel.tdata .rel.tdata.* .rel.gnu.linkonce.td.*)
      *(.rel.tbss .rel.tbss.* .rel.gnu.linkonce.tb.*)
      *(.rel.ctors)
      *(.rel.dtors)
      *(.rel.got)
      *(.rel.sdata .rel.sdata.* .rel.gnu.linkonce.s.*)
      *(.rel.sbss .rel.sbss.* .rel.gnu.linkonce.sb.*)
      *(.rel.sdata2 .rel.sdata2.* .rel.gnu.linkonce.s2.*)
      *(.rel.sbss2 .rel.sbss2.* .rel.gnu.linkonce.sb2.*)
      *(.rel.bss .rel.bss.* .rel.gnu.linkonce.b.*)
    }
  .rela.dyn       :
    {
      *(.rela.init)
      *(.rela.text .rela.text.* .rela.gnu.linkonce.t.*)
      *(.rela.fini)
      *(.rela.rodata .rela.rodata.* .rela.gnu.linkonce.r.*)
      *(.rela.data .rela.data.* .rela.gnu.linkonce.d.*)
      *(.rela.tdata .rela.tdata.* .rela.gnu.linkonce.td.*)
      *(.rela.tbss .rela.tbss.* .rela.gnu.linkonce.tb.*)
      *(.rela.ctors)
      *(.rela.dtors)
      *(.rela.got)
      *(.rela.sdata .rela.sdata.* .rela.gnu.linkonce.s.*)
      *(.rela.sbss .rela.sbss.* .rela.gnu.linkonce.sb.*)
      *(.rela.sdata2 .rela.sdata2.* .rela.gnu.linkonce.s2.*)
      *(.rela.sbss2 .rela.sbss2.* .rela.gnu.linkonce.sb2.*)
      *(.rela.bss .rela.bss.* .rela.gnu.linkonce.b.*)
    }
  .rel.plt        : { *(.rel.plt) }
  .rela.plt       : { *(.rela.plt) }
  .plt            : { *(.plt) }
  PROVIDE (__etext = .);
  PROVIDE (_etext = .);
  PROVIDE (etext = .);
  .rodata         : 
  { 
    *(.rodata .rodata.* .gnu.linkonce.r.*) 
    . = ALIGN(4);
    __tdata_align = .;
    LONG (ALIGNOF(.tdata));
    . = ALIGN(4);
    __tbss_align = .;
    LONG (ALIGNOF(.tbss));
    . = ALIGN(4);
  }
  .rodata1        : { *(.rodata1) }
  .sdata2         :
  {
    *(.sdata2 .sdata2.* .gnu.linkonce.s2.*)
  }
  .sbss2          : { *(.sbss2 .sbss2.* .gnu.linkonce.sb2.*) }
  .eh_frame_hdr : { *(.eh_frame_hdr) }
  .eh_frame       : ONLY_IF_RO { KEEP (*(.eh_frame)) }
  .gcc_except_table   : ONLY_IF_RO { *(.gcc_except_table .gcc_except_table.*) }
  /* Adjust the address for the data segment.  We want to adjust up to
     the same address within the page on the next page up.  */
  . = ALIGN(128) + (. & (128 - 1));
  /* Exception handling  */
  .eh_frame       : ONLY_IF_RW { KEEP (*(.eh_frame)) }
  .gcc_except_table   : ONLY_IF_RW { *(.gcc_except_table .gcc_except_table.*) }
  /* Thread Local Storage sections  */
  .tdata	  : 
  { 
    __tdata_start = .;
    *(.tdata .tdata.* .gnu.linkonce.td.*) 
  }
  __tdata_size = SIZEOF(.tdata);
  .tbss	(NOLOAD)	  : 
  { 
    *(.tbss .tbss.* .gnu.linkonce.tb.*) 
    *(.tcommon)
  }
  __tbss_size = SIZEOF(.tbss);
  .preinit_array     :
  {
    PROVIDE_HIDDEN (__preinit_array_start = .);
    KEEP (*(.preinit_array))
    PROVIDE_HIDDEN (__preinit_array_end = .);
  }
  .init_array     :
  {
     PROVIDE_HIDDEN (__init_array_start = .);
     KEEP (*(SORT(.init_array.*)))
     KEEP (*(.init_array))
     PROVIDE_HIDDEN (__init_array_end = .);
  }
  .fini_array     :
  {
    PROVIDE_HIDDEN (__fini_array_start = .);
    KEEP (*(.fini_array))
    KEEP (*(SORT(.fini_array.*)))
    PROVIDE_HIDDEN (__fini_array_end = .);
  }
  .ctors          :
  {
    ___ctors = .;
    /* gcc uses crtbegin.o to find the start of
       the constructors, so we make sure it is
       first.  Because this is a wildcard, it
       doesn't matter if the user does not
       actually link against crtbegin.o; the
       linker won't look for a file to match a
       wildcard.  The wildcard also means that it
       doesn't matter which directory crtbegin.o
       is in.  */
    KEEP (*crtbegin.o(.ctors))
    KEEP (*crtbegin?.o(.ctors))
    /* We don't want to include the .ctor section from
       the crtend.o file until after the sorted ctors.
       The .ctor section from the crtend file contains the
       end of ctors marker and it must be last */
    KEEP (*(EXCLUDE_FILE (*crtend.o *crtend?.o ) .ctors))
    KEEP (*(SORT(.ctors.*)))
    KEEP (*(.ctors))
    ___ctors_end = .;
  }
  .dtors          :
  {
    ___dtors = .;
    KEEP (*crtbegin.o(.dtors))
    KEEP (*crtbegin?.o(.dtors))
    KEEP (*(EXCLUDE_FILE (*crtend.o *crtend?.o ) .dtors))
    KEEP (*(SORT(.dtors.*)))
    KEEP (*(.dtors))
    ___dtors_end = .;
  }
  .jcr            : { KEEP (*(.jcr)) }
  .data.rel.ro : { *(.data.rel.ro.local* .gnu.linkonce.d.rel.ro.local.*) *(.data.rel.ro* .gnu.linkonce.d.rel.ro.*) }
  .dynamic        : { *(.dynamic) }
  .data           :
  {
    *(.data .data.* .gnu.linkonce.d.*)
    SORT(CONSTRUCTORS)
  }
  .data1          : { *(.data1) }
  .got            : { *(.got.plt) *(.got) }
  /* We want the small data sections together, so single-instruction offsets
     can access them all, and initialized data all before uninitialized, so
     we can shorten the on-disk segment size.  */
  .sdata          :
  {
    *(.sdata .sdata.* .gnu.linkonce.s.*)
  }
  _edata = .; PROVIDE (edata = .);
  . = ALIGN(8);
  __monitors_start = .;
  .monitors       :
  {
    *(.monitors)
  }
  __monitors_end = .;
  . = ALIGN(8);
  __bss_start = .;
  .sbss           :
  {
    *(.dynsbss)
    *(.sbss .sbss.* .gnu.linkonce.sb.*)
    *(.scommon)
  }
  .bss            :
  {
   *(.dynbss)
   *(.bss .bss.* .gnu.linkonce.b.*)
   *(COMMON)
   /* Align here to ensure that the .bss section occupies space up to
      _end.  Align after .bss to ensure correct alignment even if the
      .bss section disappears because there are no input sections.
      FIXME: Why do we need it? When there is no .bss section, we don't
      pad the .data section.  */
   . = ALIGN(. != 0 ? 32 / 8 : 1);
  }
  . = ALIGN(32 / 8);
  . = ALIGN(32 / 8);
  _end = .; PROVIDE (end = .);
  .ocram 0x7c001000 (NOLOAD) :
  {
    *(.ocram)
    /* We have 8kb of operand cache RAM. The next line lets ld throw
       an error if we exceed that size.  */
    . = . > 0x2000 ? 0x2000 : .;
  }
  /* Stabs debugging sections.  */
  .stab          0 : { *(.stab) }
  .stabstr       0 : { *(.stabstr) }
  .stab.excl     0 : { *(.stab.excl) }
  .stab.exclstr  0 : { *(.stab.exclstr) }
  .stab.index    0 : { *(.stab.index) }
  .stab.indexstr 0 : { *(.stab.indexstr) }
  .comment       0 : { *(.comment) }
  /* DWARF debug sections.
     Symbols in the DWARF debugging sections are relative to the beginning
     of the section so we begin them at 0.  */
  /* DWARF 1 */
  .debug          0 : { *(.debug) }
  .line           0 : { *(.line) }
  /* GNU DWARF 1 extensions */
  .debug_srcinfo  0 : { *(.debug_srcinfo) }
  .debug_sfnames  0 : { *(.debug_sfnames) }
  /* DWARF 1.1 and DWARF 2 */
  .debug_aranges  0 : { *(.debug_aranges) }
  .debug_pubnames 0 : { *(.debug_pubnames) }
  /* DWARF 2 */
  .debug_info     0 : { *(.debug_info .gnu.linkonce.wi.*) }
  .debug_abbrev   0 : { *(.debug_abbrev) }
  .debug_line     0 : { *(.debug_line) }
  .debug_frame    0 : { *(.debug_frame) }
  .debug_str      0 : { *(.debug_str) }
  .debug_loc      0 : { *(.debug_loc) }
  .debug_macinfo  0 : { *(.debug_macinfo) }
  /* SGI/MIPS DWARF 2 extensions */
  .debug_weaknames 0 : { *(.debug_weaknames) }
  .debug_funcnames 0 : { *(.debug_funcnames) }
  .debug_typenames 0 : { *(.debug_typenames) }
  .debug_varnames  0 : { *(.debug_varnames) }
  /* DWARF 3 */
  .debug_pubtypes 0 : { *(.debug_pubtypes) }
  .debug_ranges   0 : { *(.debug_ranges) }
  .gnu.attributes 0 : { KEEP (*(.gnu.attributes)) }
  /DISCARD/ : { *(.note.GNU-stack) *(.gnu_debuglink) }
}
